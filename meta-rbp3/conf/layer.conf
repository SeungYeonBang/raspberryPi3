## meta-rbp3/conf/layer.conf
```bitbake
# We have a conf and classes directory, add to BBPATH
BBPATH .= ":${LAYERDIR}"

# We have recipes-* directories, add to BBFILES
BBFILES += "${LAYERDIR}/recipes-*/*/*.bb \
            ${LAYERDIR}/recipes-*/*/*.bbappend"

BBFILE_COLLECTIONS += "rbp3"
BBFILE_PATTERN_rbp3 = "^${LAYERDIR}/"
BBFILE_PRIORITY_rbp3 = "7"

LAYERDEPENDS_rbp3 += "core"

LAYERVERSION_rbp3 = "1"

LAYERSERIES_COMPAT_rbp3 = "kirkstone"

UBOOT_EXTLINUX_KERNEL_ARGS:append = " quiet loglevel=0 vt.global_cursor_default=0 net.ifnames=0"
```
